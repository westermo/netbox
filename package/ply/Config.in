## package/ply/Config.in
```kconfig
config BR2_PACKAGE_PLY
	bool "ply"
	help
	  Light-weight dynamic tracer for Linux.

	  https://github.com/wkz/ply
```

## package/sysklogd2/Config.in
```kconfig
config BR2_PACKAGE_SYSKLOGD2
	bool "sysklogd2 - BSD syslogd with support for RFC5424"
	depends on BR2_USE_MMU # Uses fork()
	help
          The continuation of the original sysklogd package, based on
	  the original Berkeley syslog daemon.  Now with kernel logging,
	  and log rotation built-in.  It ca both receive from and send
	  to remote syslog servers.  The v2.x series include extended
	  support for RFC5424 with an alt. syslogp() API for clients.
	  
	  https://github.com/troglobit/sysklogd/
```

## package/watchdogd/Config.in
```kconfig
config BR2_PACKAGE_WATCHDOGD
        bool "watchdogd - Advanced Watchdog Daemon"
        depends on BR2_USE_MMU # fork()
	select BR2_PACKAGE_LIBCONFUSE
	select BR2_PACKAGE_LIBITE
	select BR2_PACKAGE_LIBUEV
        help
          Extended version of uClinux-dist watchdogd.  Monitors loadavg,
 	  file descriptors and memory leaks, and capable of supervising
 	  your processes main loop using an instrumentation API.

	  https://github.com/troglobit/watchdogd/
```

## package/westermo-dts/Config.in
```kconfig
config BR2_PACKAGE_WESTERMO_DTS
	bool "westermo-dts"
	default y if NETBOX_PLAT_CORONET
	depends on BR2_LINUX_KERNEL
	select BR2_PACKAGE_HOST_DTC
	help
	  Devicetrees for switches and routers from Westermo.

	  https://www.westermo.com/products/ethernet-switches
```
