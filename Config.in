## Config.in
```kconfig
menu "Branding"

config NETBOX_PLAT
	string "Single word lower-case identifier for the platform"
	default "basis"   if BR2_arm926t
	default "coronet" if BR2_powerpc
	default "dagger"  if BR2_arm
	default "envoy"   if BR2_aarch64
	default "zero"    if BR2_x86_64
	default BR2_ARCH

config NETBOX_VENDOR_ID
	string "Single word lower-case identifier for the operating system"
	default "netbox"
	help
	  A lower-case string (no spaces or other characters outside of
          0–9, a–z, '.', '_' and '-') identifying the operating system,
          excluding any version information and suitable for processing
          by scripts or usage in generated filenames.

	  Used for identifying the OS, e.g. as ID in /etc/os-release and
	  in the generated image name: ID-TYPE-PLAT.img

config NETBOX_VENDOR_NAME
	string "String identifier for the operating system"
	default "NetBox"
	help
	  Used for identifying the OS, e.g. as NAME in /etc/os-release

config NETBOX_VENDOR_DESC
	string "Pretty operating system name, format for presentation to user"
	default "NetBox - The Networking Toolbox"
	help
	  Used for identifying the OS, e.g. as PRETTY_NAME in /etc/os-release

config NETBOX_VENDOR_HOME
	string "Internet URL for the homepage of the operating system"
	default "https://github.com/westermo/netbox/"
	help
	  Used for identifying the OS, e.g. as HOME_URL in /etc/os-release

config NETBOX_VENDOR_VERSION
	string "Version of operating system, may be a script with ``"
	default "`$BR2_EXTERNAL_NETBOX_PATH/utils/mkversion $BR2_EXTERNAL_NETBOX_PATH`"
	help
	   A lower-case string (no spaces or other characters outside of
           0–9, a–z, '.', '_' and '-') identifying the operating system
           version, excluding any OS name information or release code
           name, and suitable for processing by scripts or usage in
           generated filenames.

	   Used for VERSION and VERSION_ID in /etc/os-release

endmenu

choice
	bool "Type"
	default NETBOX_TYPE_APP
	help
	  Select the NetBox type:

	    o Application        Basic root filesystem, no kernel
	    o Operating System   Like app + kernel

config NETBOX_TYPE_APP
	bool "Application (LXC)"
	help
	  Application build for the chosen CPU platform.  This only
	  creates a root filesystem, no kernel is built.

	  This is typically suitable for container images (LXC), but can
	  also be useful for systems where a pre-built kernel exists
	  already.

	  Selecting this pre-selects the app profile option (below),
	  this is only a recommendation.

config NETBOX_TYPE_OS
	bool "Operating System (kernel + userland)"
	help
	  Complete operating system, including kernel and userland,
	  for the chosen CPU platform.

	  This is the same as the application build, but includes a
	  kernel, and optionally a (second) stage bootloader.

	  Selecting this pre-selects the OS profile option (below),
	  this is only a recommendation.

endchoice

config NETBOX_TYPE
	string
	default "app" if NETBOX_TYPE_APP
	default "os"  if NETBOX_TYPE_OS

choice
	bool "Profile"
	default NETBOX_PROFILE_APP if NETBOX_TYPE_APP
	default NETBOX_PROFILE_OS  if NETBOX_TYPE_OS
	help
	  NetBox is built around BusyBox and Finit.  Comprising the very
	  core of the exprience of this embedded system.  On top of that
	  two main profiles are available; slimmed down applications or
	  full-blown operating systems.

	    o Applicaiton        Finit + Dropbear SSH + tcpdump
	    o Operating System   Finit + lots of tools & daemons
	    o Custom             Finit

	  See each profile for details.

config NETBOX_PROFILE_CUSTOM
	bool "Custom (minimal)"
	select BR2_PACKAGE_FINIT
	help
	  The custom profile allows more fine grained control over what
	  packages are included.  However, NetBox always has Finit as
	  its preferred init.  If you want something else, you should
	  probably skip NetBox and use buildroot directly.

config NETBOX_PROFILE_APP
	bool "Appplication (basic)"
	help
	  The application profile includes a set of basic packages
	  that usually are essential to a basic contatainer app:

	    o Dropbear SSH (server + client)
	    o tcpdump

	  SSH in to your container from remote, and support to debug
	  network connections in case SSH connection fails.

	  If you want to create a really small app and do not need these
	  tools, use the custom profile or use buildroot directly.

config NETBOX_PROFILE_OS
	bool "Operating System (full)"
	help
	  The operating system profile comes with a lot more features
	  compared to the other profiles.  The intention is to provide
	  common network services and also tools for debugging network
	  devices on all the different layers in the stack of a switch
	  or router product.

	  This profile will likely expand and change a lot over time.
	  Use the custom profile to get more fine grained control.

endchoice

config NETBOX_PROFILE
	string
	default "app"     if NETBOX_PROFILE_APP
	default "os"      if NETBOX_PROFILE_OS
	default "custom"  if NETBOX_PROFILE_CUSTOM

menu "Developer"

config NETBOX_IMAGE_FIT
	bool "Build FIT image"
	depends on NETBOX_TYPE_OS
	select BR2_PACKAGE_HOST_UBOOT_TOOLS
	select BR2_PACKAGE_HOST_UBOOT_TOOLS_FIT_SUPPORT
	select BR2_PACKAGE_HOST_UBOOT_TOOLS_FIT_SIGNATURE_SUPPORT
	help
	  Build an FIT image with all device trees in boot/, creating a
	  configuration for each, the default kernel and the SquashFS as
	  a ramdisk.

	  This is useful for testing NetBox on systems which do not have
	  a bootloader capable of loading standard images, e.g. U-Boot
	  on various evaluation/development boards.

endmenu

menu "Packages"

source "$BR2_EXTERNAL_NETBOX_PATH/package/Config.in"

endmenu
```

## board/basis/linux_defconfig
```kconfig
# CONFIG_LOCALVERSION_AUTO is not set
CONFIG_DEFAULT_HOSTNAME="basis"
# CONFIG_SWAP is not set
CONFIG_SYSVIPC=y
CONFIG_NO_HZ_IDLE=y
CONFIG_HIGH_RES_TIMERS=y
CONFIG_BPF_SYSCALL=y
CONFIG_BPF_JIT=y
CONFIG_LOG_BUF_SHIFT=18
CONFIG_CGROUPS=y
CONFIG_MEMCG=y
CONFIG_BLK_CGROUP=y
CONFIG_CGROUP_SCHED=y
CONFIG_CFS_BANDWIDTH=y
CONFIG_RT_GROUP_SCHED=y
CONFIG_CGROUP_PIDS=y
CONFIG_CGROUP_FREEZER=y
CONFIG_CGROUP_CPUACCT=y
CONFIG_NAMESPACES=y
CONFIG_USER_NS=y
CONFIG_BLK_DEV_INITRD=y
# CONFIG_RD_BZIP2 is not set
# CONFIG_RD_LZMA is not set
# CONFIG_RD_LZO is not set
# CONFIG_RD_LZ4 is not set
CONFIG_CC_OPTIMIZE_FOR_SIZE=y
CONFIG_EMBEDDED=y
CONFIG_SLAB=y
# CONFIG_ARCH_MULTI_V7 is not set
CONFIG_ARCH_AT91=y
CONFIG_ATMEL_CLOCKSOURCE_TCB=y
CONFIG_ARCH_MXC=y
CONFIG_SOC_IMX27=y
CONFIG_ARCH_VERSATILE=y
# CONFIG_ARM_THUMB is not set
CONFIG_AEABI=y
CONFIG_UACCESS_WITH_MEMCPY=y
CONFIG_KEXEC=y
# CONFIG_SUSPEND is not set
CONFIG_KPROBES=y
# CONFIG_SECCOMP is not set
CONFIG_STRICT_KERNEL_RWX=y
CONFIG_STRICT_MODULE_RWX=y
# CONFIG_GCC_PLUGINS is not set
CONFIG_MODULES=y
# CONFIG_BLK_DEV_BSG is not set
CONFIG_IOSCHED_BFQ=y
# CONFIG_CORE_DUMP_DEFAULT_ELF_HEADERS is not set
CONFIG_BINFMT_MISC=y
CONFIG_NET=y
CONFIG_PACKET=y
CONFIG_UNIX=y
CONFIG_INET=y
CONFIG_IP_MULTICAST=y
CONFIG_IP_ADVANCED_ROUTER=y
CONFIG_IP_MULTIPLE_TABLES=y
CONFIG_IP_ROUTE_MULTIPATH=y
CONFIG_IP_PNP=y
CONFIG_IP_PNP_DHCP=y
CONFIG_IP_PNP_BOOTP=y
CONFIG_IP_PNP_RARP=y
CONFIG_NET_IPIP=m
CONFIG_NET_IPGRE_DEMUX=m
CONFIG_NET_IPGRE=m
CONFIG_NET_IPGRE_BROADCAST=y
CONFIG_IP_MROUTE=y
CONFIG_IP_MROUTE_MULTIPLE_TABLES=y
CONFIG_IP_PIMSM_V1=y
CONFIG_IP_PIMSM_V2=y
CONFIG_NET_IPVTI=y
# CONFIG_INET_DIAG is not set
CONFIG_TCP_CONG_ADVANCED=y
CONFIG_IPV6_ROUTER_PREF=y
CONFIG_IPV6_ROUTE_INFO=y
CONFIG_IPV6_OPTIMISTIC_DAD=y
CONFIG_IPV6_VTI=y
CONFIG_IPV6_SIT_6RD=y
CONFIG_IPV6_MULTIPLE_TABLES=y
CONFIG_IPV6_SUBTREES=y
CONFIG_IPV6_MROUTE=y
CONFIG_IPV6_MROUTE_MULTIPLE_TABLES=y
CONFIG_IPV6_PIMSM_V2=y
CONFIG_NETFILTER=y
CONFIG_NF_TABLES=y
CONFIG_NF_TABLES_INET=y
CONFIG_BRIDGE=y
CONFIG_BRIDGE_VLAN_FILTERING=y
CONFIG_NET_DSA=y
CONFIG_VLAN_8021Q=y
CONFIG_NETLINK_DIAG=y
# CONFIG_WIRELESS is not set
CONFIG_NET_9P=y
CONFIG_NET_9P_VIRTIO=y
CONFIG_PCI=y
CONFIG_PCI_VERSATILE=y
CONFIG_DEVTMPFS=y
CONFIG_DEVTMPFS_MOUNT=y
# CONFIG_STANDALONE is not set
# CONFIG_PREVENT_FIRMWARE_BUILD is not set
CONFIG_IMX_WEIM=y
CONFIG_MTD=y
CONFIG_MTD_CMDLINE_PARTS=y
CONFIG_MTD_BLOCK=y
CONFIG_MTD_CFI=y
CONFIG_MTD_CFI_INTELEXT=y
CONFIG_MTD_CFI_AMDSTD=y
CONFIG_MTD_PHYSMAP=y
CONFIG_MTD_PHYSMAP_OF=y
CONFIG_MTD_BLOCK2MTD=y
CONFIG_MTD_SPI_NOR=y
CONFIG_BLK_DEV_LOOP=y
CONFIG_BLK_DEV_RAM=y
CONFIG_BLK_DEV_RAM_COUNT=4
CONFIG_BLK_DEV_RAM_SIZE=8192
CONFIG_ATMEL_SSC=y
CONFIG_EEPROM_AT24=y
CONFIG_EEPROM_93CX6=y
CONFIG_SCSI=y
CONFIG_BLK_DEV_SD=y
CONFIG_SCSI_VIRTIO=y
CONFIG_NETDEVICES=y
CONFIG_DUMMY=y
CONFIG_NET_TEAM=y
CONFIG_VETH=y
CONFIG_VIRTIO_NET=y
CONFIG_NET_DSA_MV88E6XXX=y
# CONFIG_NET_VENDOR_ALACRITECH is not set
# CONFIG_NET_VENDOR_AMAZON is not set
# CONFIG_NET_VENDOR_AQUANTIA is not set
# CONFIG_NET_VENDOR_ARC is not set
# CONFIG_NET_VENDOR_BROADCOM is not set
CONFIG_MACB=y
# CONFIG_NET_VENDOR_CAVIUM is not set
# CONFIG_NET_VENDOR_CIRRUS is not set
# CONFIG_NET_VENDOR_CORTINA is not set
# CONFIG_NET_VENDOR_EZCHIP is not set
# CONFIG_NET_VENDOR_FARADAY is not set
# CONFIG_NET_VENDOR_GOOGLE is not set
# CONFIG_NET_VENDOR_HISILICON is not set
# CONFIG_NET_VENDOR_HUAWEI is not set
# CONFIG_NET_VENDOR_INTEL is not set
# CONFIG_NET_VENDOR_MELLANOX is not set
# CONFIG_NET_VENDOR_MICREL is not set
# CONFIG_NET_VENDOR_MICROCHIP is not set
# CONFIG_NET_VENDOR_MICROSEMI is not set
# CONFIG_NET_VENDOR_NATSEMI is not set
# CONFIG_NET_VENDOR_NETRONOME is not set
# CONFIG_NET_VENDOR_NI is not set
# CONFIG_NET_VENDOR_PENSANDO is not set
# CONFIG_NET_VENDOR_QUALCOMM is not set
# CONFIG_NET_VENDOR_RENESAS is not set
# CONFIG_NET_VENDOR_ROCKER is not set
# CONFIG_NET_VENDOR_SAMSUNG is not set
# CONFIG_NET_VENDOR_SEEQ is not set
# CONFIG_NET_VENDOR_SOLARFLARE is not set
# CONFIG_NET_VENDOR_SMSC is not set
# CONFIG_NET_VENDOR_SOCIONEXT is not set
# CONFIG_NET_VENDOR_STMICRO is not set
# CONFIG_NET_VENDOR_SYNOPSYS is not set
# CONFIG_NET_VENDOR_VIA is not set
# CONFIG_NET_VENDOR_WIZNET is not set
# CONFIG_NET_VENDOR_XILINX is not set
CONFIG_SFP=y
CONFIG_MARVELL_PHY=y
CONFIG_MICROCHIP_PHY=y
# CONFIG_WLAN is not set
CONFIG_INPUT_EVDEV=y
# CONFIG_KEYBOARD_ATKBD is not set
CONFIG_KEYBOARD_QT1070=y
CONFIG_KEYBOARD_GPIO=y
# CONFIG_INPUT_MOUSE is not set
CONFIG_INPUT_TOUCHSCREEN=y
CONFIG_TOUCHSCREEN_ATMEL_MXT=y
# CONFIG_SERIO is not set
CONFIG_VT_HW_CONSOLE_BINDING=y
CONFIG_LEGACY_PTY_COUNT=4
CONFIG_SERIAL_AMBA_PL011=y
CONFIG_SERIAL_AMBA_PL011_CONSOLE=y
CONFIG_SERIAL_ATMEL=y
CONFIG_SERIAL_ATMEL_CONSOLE=y
CONFIG_SERIAL_IMX=y
CONFIG_SERIAL_IMX_CONSOLE=y
# CONFIG_SERIAL_IMX_EARLYCON is not set
CONFIG_VIRTIO_CONSOLE=y
CONFIG_HW_RANDOM=y
CONFIG_I2C=y
CONFIG_I2C_CHARDEV=y
CONFIG_I2C_AT91=y
CONFIG_I2C_GPIO=y
CONFIG_I2C_IMX=y
CONFIG_I2C_VERSATILE=y
CONFIG_SPI=y
CONFIG_SPI_ATMEL=y
CONFIG_SPI_GPIO=y
CONFIG_SPI_IMX=y
# CONFIG_PTP_1588_CLOCK is not set
CONFIG_PINCTRL_AT91=y
CONFIG_PINCTRL_AT91PIO4=y
CONFIG_GPIO_SYSFS=y
CONFIG_GPIO_MXC=y
CONFIG_GPIO_PCF857X=y
CONFIG_GPIO_74X164=y
CONFIG_POWER_RESET_AT91_POWEROFF=y
CONFIG_POWER_RESET_AT91_RESET=y
CONFIG_POWER_RESET_AT91_SAMA5D2_SHDWC=y
CONFIG_POWER_SUPPLY=y
CONFIG_BATTERY_ACT8945A=y
CONFIG_SENSORS_DS1621=y
CONFIG_SENSORS_JC42=y
CONFIG_SENSORS_PCF8591=y
CONFIG_THERMAL=y
CONFIG_IMX_THERMAL=y
CONFIG_WATCHDOG=y
CONFIG_AT91SAM9X_WATCHDOG=y
CONFIG_SAMA5D4_WATCHDOG=y
CONFIG_IMX2_WDT=y
CONFIG_I6300ESB_WDT=y
CONFIG_MFD_ACT8945A=y
CONFIG_MFD_ATMEL_FLEXCOM=y
CONFIG_MFD_ATMEL_HLCDC=y
CONFIG_REGULATOR=y
CONFIG_REGULATOR_FIXED_VOLTAGE=y
CONFIG_REGULATOR_ACT8865=y
CONFIG_REGULATOR_ACT8945A=y
CONFIG_REGULATOR_GPIO=y
# CONFIG_HID is not set
CONFIG_MMC=y
CONFIG_MMC_SDHCI=y
CONFIG_MMC_SDHCI_PLTFM=y
CONFIG_MMC_SDHCI_OF_AT91=y
CONFIG_MMC_ATMELMCI=y
CONFIG_NEW_LEDS=y
CONFIG_LEDS_CLASS=y
CONFIG_LEDS_GPIO=y
CONFIG_LEDS_TRIGGERS=y
CONFIG_LEDS_TRIGGER_TIMER=y
CONFIG_LEDS_TRIGGER_HEARTBEAT=y
CONFIG_LEDS_TRIGGER_GPIO=y
CONFIG_RTC_CLASS=y
CONFIG_RTC_DRV_AT91RM9200=y
CONFIG_RTC_DRV_MXC=y
CONFIG_DMADEVICES=y
CONFIG_AT_HDMAC=y
CONFIG_AT_XDMAC=y
CONFIG_IMX_DMA=y
CONFIG_SYNC_FILE=y
CONFIG_VIRTIO_PCI=y
CONFIG_VIRTIO_INPUT=y
CONFIG_VIRTIO_MMIO=y
# CONFIG_IOMMU_SUPPORT is not set
CONFIG_PM_DEVFREQ=y
CONFIG_ARM_IMX_BUS_DEVFREQ=y
CONFIG_MEMORY=y
CONFIG_PWM=y
CONFIG_PWM_IMX27=y
# CONFIG_IMX_IRQSTEER is not set
CONFIG_EXT2_FS=y
CONFIG_EXT3_FS=y
CONFIG_EXT3_FS_POSIX_ACL=y
CONFIG_FS_VERITY=y
CONFIG_FS_VERITY_BUILTIN_SIGNATURES=y
CONFIG_FANOTIFY=y
CONFIG_FUSE_FS=y
CONFIG_VIRTIO_FS=y
CONFIG_OVERLAY_FS=y
CONFIG_VFAT_FS=y
CONFIG_TMPFS=y
CONFIG_CONFIGFS_FS=y
CONFIG_JFFS2_FS=y
CONFIG_JFFS2_SUMMARY=y
CONFIG_JFFS2_FS_XATTR=y
CONFIG_JFFS2_COMPRESSION_OPTIONS=y
CONFIG_CRAMFS=y
CONFIG_SQUASHFS=y
CONFIG_SQUASHFS_FILE_DIRECT=y
CONFIG_SQUASHFS_XATTR=y
CONFIG_SQUASHFS_LZO=y
CONFIG_SQUASHFS_XZ=y
CONFIG_SQUASHFS_ZSTD=y
CONFIG_SQUASHFS_4K_DEVBLK_SIZE=y
CONFIG_ROMFS_FS=y
CONFIG_ROMFS_BACKED_BY_MTD=y
CONFIG_NFS_FS=y
CONFIG_ROOT_NFS=y
CONFIG_9P_FS=y
CONFIG_9P_FS_POSIX_ACL=y
CONFIG_NLS_CODEPAGE_437=y
CONFIG_NLS_CODEPAGE_850=y
CONFIG_NLS_ISO8859_1=y
CONFIG_NLS_UTF8=y
CONFIG_LSM="lockdown,yama,loadpin,safesetid,integrity"
CONFIG_CRYPTO_CCM=y
CONFIG_CRYPTO_GCM=y
CONFIG_CRYPTO_SEQIV=y
CONFIG_CRYPTO_CMAC=y
CONFIG_CRYPTO_DEFLATE=y
CONFIG_CRYPTO_LZO=y
CONFIG_CRYPTO_ZSTD=y
CONFIG_CRYPTO_USER_API_HASH=y
CONFIG_CRYPTO_USER_API_SKCIPHER=y
CONFIG_CRYPTO_DEV_ATMEL_AES=y
CONFIG_CRYPTO_DEV_ATMEL_TDES=y
CONFIG_CRYPTO_DEV_ATMEL_SHA=y
CONFIG_CRYPTO_DEV_VIRTIO=y
CONFIG_CRC_CCITT=y
CONFIG_CRC_ITU_T=y
CONFIG_DEBUG_INFO=y
CONFIG_GDB_SCRIPTS=y
CONFIG_STRIP_ASM_SYMS=y
CONFIG_DEBUG_FS=y
CONFIG_DEBUG_MEMORY_INIT=y
# CONFIG_SCHED_DEBUG is not set
CONFIG_FUNCTION_TRACER=y
CONFIG_DEBUG_USER=y
```
