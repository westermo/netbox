## configs/netbox_os_basis_defconfig
```kconfig
BR2_arm=y
BR2_ENABLE_DEBUG=y
BR2_GLOBAL_PATCH_DIR="$(BR2_EXTERNAL_NETBOX_PATH)/patches"
BR2_TOOLCHAIN_EXTERNAL=y
BR2_TOOLCHAIN_EXTERNAL_BOOTLIN=y
BR2_TOOLCHAIN_EXTERNAL_BOOTLIN_AARCH64_GLIBC_STABLE=y
BR2_TOOLCHAIN_EXTERNAL_GDB_SERVER_COPY=y
BR2_TARGET_GENERIC_HOSTNAME="basis"
BR2_TARGET_GENERIC_ISSUE="NetBox - The Networking Toolbox"
BR2_INIT_NONE=y
BR2_ROOTFS_OVERLAY="$(BR2_EXTERNAL_NETBOX_PATH)/board/common/os/rootfs"
BR2_ROOTFS_POST_BUILD_SCRIPT="$(BR2_EXTERNAL_NETBOX_PATH)/board/common/post-build.sh"
BR2_ROOTFS_POST_IMAGE_SCRIPT="$(BR2_EXTERNAL_NETBOX_PATH)/board/common/post-image.sh"
BR2_LINUX_KERNEL=y
BR2_LINUX_KERNEL_USE_CUSTOM_CONFIG=y
BR2_LINUX_KERNEL_CUSTOM_CONFIG_FILE="$(BR2_EXTERNAL_NETBOX_PATH)/board/basis/linux_defconfig"
BR2_LINUX_KERNEL_XZ=y
BR2_LINUX_KERNEL_INSTALL_TARGET=y
BR2_PACKAGE_BUSYBOX_CONFIG="$(BR2_EXTERNAL_NETBOX_PATH)/board/common/busybox.config"
BR2_PACKAGE_BUSYBOX_SHOW_OTHERS=y
BR2_PACKAGE_UBOOT_TOOLS=y
# BR2_PACKAGE_UBOOT_TOOLS_FWPRINTENV is not set
BR2_PACKAGE_DROPBEAR=y
BR2_TARGET_ROOTFS_SQUASHFS=y
BR2_TARGET_ROOTFS_SQUASHFS4_XZ=y
# BR2_TARGET_ROOTFS_TAR is not set
BR2_PACKAGE_HOST_SQUASHFS=y
BR2_PACKAGE_HOST_UBOOT_TOOLS=y
BR2_PACKAGE_HOST_UBOOT_TOOLS_FIT_SUPPORT=y
BR2_PACKAGE_HOST_UBOOT_TOOLS_FIT_SIGNATURE_SUPPORT=y
NETBOX_TYPE_OS=y
NETBOX_META_PACKAGE=y
```

## configs/netbox_os_coronet_defconfig
```kconfig
BR2_powerpc=y
BR2_ENABLE_DEBUG=y
BR2_TOOLCHAIN_EXTERNAL=y
BR2_TOOLCHAIN_EXTERNAL_DOWNLOAD=y
BR2_TOOLCHAIN_EXTERNAL_URL="https://github.com/myrootfs/crosstool-ng/releases/download/troglobit%2F7.3.0-1/$(ARCH)-unknown-linux-gnu-7.3.0-1.tar.xz"
BR2_TOOLCHAIN_EXTERNAL_CUSTOM_PREFIX="$(ARCH)-unknown-linux-gnu"
BR2_TOOLCHAIN_EXTERNAL_GCC_7=y
BR2_TOOLCHAIN_EXTERNAL_HEADERS_4_15=y
BR2_TOOLCHAIN_EXTERNAL_CUSTOM_GLIBC=y
BR2_TOOLCHAIN_EXTERNAL_CXX=y
BR2_TOOLCHAIN_EXTERNAL_GDB_SERVER_COPY=y
BR2_TARGET_GENERIC_HOSTNAME="coronet"
BR2_TARGET_GENERIC_ISSUE="NetBox - The Networking Toolbox"
BR2_ROOTFS_OVERLAY="$(BR2_EXTERNAL_NETBOX_PATH)/board/common/os/rootfs"
BR2_ROOTFS_POST_BUILD_SCRIPT="$(BR2_EXTERNAL)/board/common/post-build.sh"
BR2_ROOTFS_POST_IMAGE_SCRIPT="$(BR2_EXTERNAL)/board/common/post-image.sh"
BR2_LINUX_KERNEL=y
BR2_LINUX_KERNEL_USE_CUSTOM_CONFIG=y
BR2_LINUX_KERNEL_CUSTOM_CONFIG_FILE="$(BR2_EXTERNAL_NETBOX_PATH)/board/coronet/linux_defconfig"
BR2_LINUX_KERNEL_ZIMAGE=y
BR2_LINUX_KERNEL_INSTALL_TARGET=y
BR2_PACKAGE_BUSYBOX_CONFIG_FRAGMENT_FILES="$(BR2_EXTERNAL_NETBOX_PATH)/board/common/busybox.fragment"
BR2_PACKAGE_UBOOT_TOOLS=y
# BR2_PACKAGE_UBOOT_TOOLS_FWPRINTENV is not set
BR2_PACKAGE_TCPDUMP=y
BR2_TARGET_ROOTFS_SQUASHFS=y
BR2_TARGET_ROOTFS_SQUASHFS4_XZ=y
# BR2_TARGET_ROOTFS_TAR is not set
BR2_PACKAGE_HOST_SQUASHFS=y
BR2_PACKAGE_HOST_UBOOT_TOOLS=y
BR2_PACKAGE_HOST_UBOOT_TOOLS_FIT_SUPPORT=y
BR2_PACKAGE_HOST_UBOOT_TOOLS_FIT_SIGNATURE_SUPPORT=y
NETBOX_TYPE_OS=y
NETBOX_META_PACKAGE=y
```

## configs/netbox_os_envoy_defconfig
```kconfig
BR2_aarch64=y
BR2_ENABLE_DEBUG=y
BR2_GLOBAL_PATCH_DIR="$(BR2_EXTERNAL_NETBOX_PATH)/patches"
BR2_TOOLCHAIN_EXTERNAL=y
BR2_TOOLCHAIN_EXTERNAL_BOOTLIN=y
BR2_TOOLCHAIN_EXTERNAL_BOOTLIN_AARCH64_GLIBC_STABLE=y
BR2_TOOLCHAIN_EXTERNAL_GDB_SERVER_COPY=y
BR2_TARGET_GENERIC_HOSTNAME="envoy"
BR2_TARGET_GENERIC_ISSUE="NetBox - The Networking Toolbox"
BR2_INIT_NONE=y
BR2_ROOTFS_OVERLAY="$(BR2_EXTERNAL_NETBOX_PATH)/board/common/os/rootfs"
BR2_ROOTFS_POST_BUILD_SCRIPT="$(BR2_EXTERNAL_NETBOX_PATH)/board/common/post-build.sh"
BR2_ROOTFS_POST_IMAGE_SCRIPT="$(BR2_EXTERNAL_NETBOX_PATH)/board/common/post-image.sh"
BR2_LINUX_KERNEL=y
BR2_LINUX_KERNEL_USE_CUSTOM_CONFIG=y
BR2_LINUX_KERNEL_CUSTOM_CONFIG_FILE="$(BR2_EXTERNAL_NETBOX_PATH)/board/$(NETBOX_PLAT)/linux_defconfig"
BR2_LINUX_KERNEL_DTS_SUPPORT=y
BR2_LINUX_KERNEL_INTREE_DTS_NAME="marvell/armada-3720-espressobin marvell/armada-3720-espressobin-emmc marvell/armada-3720-espressobin-v7 marvell/armada-3720-espressobin-v7-emmc"
BR2_LINUX_KERNEL_INSTALL_TARGET=y
BR2_PACKAGE_BUSYBOX_CONFIG="$(BR2_EXTERNAL_NETBOX_PATH)/board/common/busybox.config"
BR2_PACKAGE_BUSYBOX_SHOW_OTHERS=y
BR2_TARGET_ROOTFS_EXT2=y
BR2_TARGET_ROOTFS_EXT2_4=y
BR2_TARGET_ROOTFS_EXT2_SIZE="120M"
BR2_TARGET_ROOTFS_SQUASHFS=y
# BR2_TARGET_ROOTFS_TAR is not set
BR2_PACKAGE_HOST_GENIMAGE=y
BR2_PACKAGE_HOST_SQUASHFS=y
NETBOX_TYPE_OS=y
NETBOX_META_PACKAGE=y
```

## configs/netbox_os_zero_defconfig
```kconfig
BR2_x86_64=y
BR2_ENABLE_DEBUG=y
BR2_GLOBAL_PATCH_DIR="$(BR2_EXTERNAL_NETBOX_PATH)/patches"
BR2_TOOLCHAIN_EXTERNAL=y
BR2_TOOLCHAIN_EXTERNAL_DOWNLOAD=y
BR2_TOOLCHAIN_EXTERNAL_URL="https://github.com/myrootfs/crosstool-ng/releases/download/troglobit%2F7.3.0-1/$(ARCH)-unknown-linux-gnu-7.3.0-1.tar.xz"
BR2_TOOLCHAIN_EXTERNAL_CUSTOM_PREFIX="$(ARCH)-unknown-linux-gnu"
BR2_TOOLCHAIN_EXTERNAL_GCC_7=y
BR2_TOOLCHAIN_EXTERNAL_HEADERS_4_15=y
BR2_TOOLCHAIN_EXTERNAL_CUSTOM_GLIBC=y
BR2_TOOLCHAIN_EXTERNAL_CXX=y
BR2_TOOLCHAIN_EXTERNAL_GDB_SERVER_COPY=y
BR2_TARGET_GENERIC_HOSTNAME="zero"
BR2_TARGET_GENERIC_ISSUE="NetBox - The Networking Toolbox"
BR2_ROOTFS_POST_BUILD_SCRIPT="$(BR2_EXTERNAL_NETBOX_PATH)/board/common/post-build.sh"
BR2_ROOTFS_POST_IMAGE_SCRIPT="$(BR2_EXTERNAL_NETBOX_PATH)/board/common/post-image.sh"
BR2_LINUX_KERNEL=y
BR2_LINUX_KERNEL_CUSTOM_VERSION=y
BR2_LINUX_KERNEL_CUSTOM_VERSION_VALUE="5.4.35"
BR2_LINUX_KERNEL_USE_CUSTOM_CONFIG=y
BR2_LINUX_KERNEL_CUSTOM_CONFIG_FILE="board/qemu/x86/linux.config"
BR2_LINUX_KERNEL_NEEDS_HOST_LIBELF=y
BR2_PACKAGE_BUSYBOX_CONFIG_FRAGMENT_FILES="$(BR2_EXTERNAL_NETBOX_PATH)/board/common/busybox.fragment"
BR2_TARGET_ROOTFS_EXT2=y
# BR2_TARGET_ROOTFS_TAR is not set
NETBOX_TYPE_OS=y
NETBOX_META_PACKAGE=y
```

## configs/netbox_powerpc_defconfig
```kconfig
BR2_powerpc=y
BR2_ENABLE_DEBUG=y
BR2_TOOLCHAIN_EXTERNAL=y
BR2_TOOLCHAIN_EXTERNAL_DOWNLOAD=y
BR2_TOOLCHAIN_EXTERNAL_URL="https://github.com/myrootfs/crosstool-ng/releases/download/troglobit%2F7.3.0-1/$(ARCH)-unknown-linux-gnu-7.3.0-1.tar.xz"
BR2_TOOLCHAIN_EXTERNAL_CUSTOM_PREFIX="$(ARCH)-unknown-linux-gnu"
BR2_TOOLCHAIN_EXTERNAL_GCC_7=y
BR2_TOOLCHAIN_EXTERNAL_HEADERS_4_15=y
BR2_TOOLCHAIN_EXTERNAL_CUSTOM_GLIBC=y
BR2_TOOLCHAIN_EXTERNAL_CXX=y
BR2_TOOLCHAIN_EXTERNAL_GDB_SERVER_COPY=y
BR2_TARGET_GENERIC_HOSTNAME="netbox"
BR2_TARGET_GENERIC_ISSUE="Netbox - The Networking Toolbox"
BR2_ROOTFS_POST_BUILD_SCRIPT="$(BR2_EXTERNAL)/board/common/post-build.sh"
BR2_PACKAGE_DNSMASQ=y
BR2_PACKAGE_DROPBEAR=y
BR2_PACKAGE_INADYN=y
BR2_PACKAGE_IPROUTE2=y
BR2_PACKAGE_NFTABLES=y
BR2_PACKAGE_QUAGGA=y
BR2_PACKAGE_QUAGGA_ZEBRA=y
BR2_PACKAGE_QUAGGA_ISISD=y
BR2_PACKAGE_QUAGGA_OSPFD=y
BR2_PACKAGE_QUAGGA_OSPF6D=y
BR2_PACKAGE_QUAGGA_RIPD=y
BR2_PACKAGE_QUAGGA_RIPNGD=y
BR2_PACKAGE_QUAGGA_VTYSH=y
BR2_PACKAGE_SMCROUTE=y
BR2_PACKAGE_SOCAT=y
BR2_TARGET_ROOTFS_SQUASHFS=y
# BR2_TARGET_ROOTFS_TAR is not set
```

## modules/Config.in
```kconfig
menu "Westermo Kernel Modules"

	source "kernel/modules/hello/Config.in"

endmenu
```

## package/Config.in
```kconfig
source "$BR2_EXTERNAL_NETBOX_PATH/package/brist/Config.in"
source "$BR2_EXTERNAL_NETBOX_PATH/package/factory/Config.in"
source "$BR2_EXTERNAL_NETBOX_PATH/package/finit/Config.in"
source "$BR2_EXTERNAL_NETBOX_PATH/package/libnsh/Config.in"
source "$BR2_EXTERNAL_NETBOX_PATH/package/mcjoin/Config.in"
source "$BR2_EXTERNAL_NETBOX_PATH/package/nemesis/Config.in"
source "$BR2_EXTERNAL_NETBOX_PATH/package/querierd/Config.in"
source "$BR2_EXTERNAL_NETBOX_PATH/package/skeleton-init-finit/Config.in"
source "$BR2_EXTERNAL_NETBOX_PATH/package/tetris/Config.in"
source "$BR2_EXTERNAL_NETBOX_PATH/package/westermo-dts/Config.in"
```

## package/brist/Config.in
```kconfig
config BR2_PACKAGE_BRIST
	bool "brist - BRIdge Self Test"
	select BR2_PACKAGE_SOCAT
	select BR2_PACKAGE_TCPDUMP
	select BR2_PACKAGE_IPROUTE2
	help
	  Brist is a standalone, easy to use, portable framework to
	  verify the capabilities of the Linux bridge.  Emphasis on
	  portable.  It should be possible to run on a full-blown Linux
	  distribution, but it must be possible to run on limited
	  embedded systems.

	  Brist is written in POSIX shell script, with some scent of
	  awk, and uses tools like socat, ping, and tcpdump to do its
	  bidding.  For some tests nemesis is used, but when it is not
	  available, those tests are skipped.

          https://github.com/westermo/brist/
```

## package/finit/Config.in
```kconfig
config BR2_PACKAGE_FINIT
	bool "finit"
	depends on BR2_USE_MMU # fork()
	select BR2_PACKAGE_LIBITE
	select BR2_PACKAGE_LIBUEV
	select BR2_PACKAGE_SKELETON_INIT_FINIT # before BR2_INIT_FINIT support
	help
	  The original Asus EeePC fastinit clone, on steroids.  With process
	  supervision, plugin support, and more!

	  https://github.com/troglobit/finit
```

## package/libnsh/Config.in
```kconfig
config BR2_PACKAGE_LIBNSH
	bool "libnsh"
	select BR2_PACKAGE_NETSNMP
	select BR2_PACKAGE_NETSNMP_SERVER
	select BR2_PACKAGE_NETSNMP_ENABLE_MIBS
	help
	  This is libnsh, the "Net-SNMP helper C-library". It provides
	  a slightly simpler and more user-friendly API wrapper around
	  net-snmp.

	  If developing a subagent, you probably want to enable the
	  "agentx" module in BR2_PACKAGE_NETSNMP_WITH_MIB_MODULES
	  as well.

	  https://github.com/westermo/libnsh
```

## package/libteam/Config.in
```kconfig
config BR2_PACKAGE_LIBTEAM
	bool "libteam"
	select BR2_PACKAGE_JANSSON
	select BR2_PACKAGE_LIBDAEMON
	select BR2_PACKAGE_LIBNL
	select BR2_PACKAGE_LIBNL_TOOLS
	help
	  The purpose of the Team driver is to provide a mechanism to
	  team multiple NICs (ports) into one logical one (teamdev) at
	  L2 layer. The process is called "channel bonding", "Ethernet
	  bonding", "channel teaming", "link aggregation", etc.

	  https://github.com/jpirko/libteam
```

## package/libuev/Config.in
```kconfig
config BR2_PACKAGE_LIBUEV
	bool "libuev"
	help
	  libuEv is small event loop wraping the Linux epoll() family
	  of APIs, similar to the more established libevent and libev.
	  The µ in the name refers both to its limited feature set and
	  the size of the library.

	  https://github.com/troglobit/libuev
```

## package/mdnsd-finit/Config.in
```kconfig
config BR2_PACKAGE_MDNSD_FINIT
	bool mdnsd-finit
	select BR2_PACKAGE_AVAHI
	help
	  Advertises the initial $(HOSTNAME).local and network.local with Avahi.
```

## package/mg/Config.in
```kconfig
config BR2_PACKAGE_MG
	bool "mg - A Micro Emacs clone similar to GNU Emacs"
        depends on BR2_USE_MMU # fork()
        select BR2_PACKAGE_NCURSES
	help
	  Mg is a public domain Micro Emacs derivative.	 Created in 1986
	  based on the original MicroEMACS released by Dave Conroy in
	  1985 to comp.sources.unix.

	  The intention is to be a small, fast, and portable Emacs-like
	  editor for users who cannot, or do not want to, run the real
	  Emacs for one reason or another.  Compatibility with GNU Emacs
	  is key for Mg, separating it from other ErsatzEmacs clones,
	  because there should never be any reason to learn more than
	  one Emacs flavor.

	  https://github.com/troglobit/mg/
```

## package/modules/Config.in
```kconfig
menu "Westermo Kernel Modules"

	source "$BR2_EXTERNAL_NETBOX_PATH/modules/hello/Config.in"

endmenu
```

## package/modules/hello/Config.in
```kconfig
config MODULE_HELLO
	bool "hello"
	depends on BR2_LINUX_KERNEL
	help
	  Example Hello World kernel module.
```

## package/netcalc/Config.in
```kconfig
config BR2_PACKAGE_NETCALC
	bool "netcalc - Simplified clone of sipcalc with ipcalc looks"
	help
	  netcalc is a slimmed down clone of sipcalc, using the output
	  format of ipcalc.  It is written in C and only depends on a
	  POSIX compliant C library.  Both IPv4 and IPv6 are supported.
          
          https://github.com/troglobit/netcalc/
```
