/dts-v1/;

#include "microchip/sparx5_pcb134_emmc.dts"

&cpu0 {
	enable-method = "spin-table";
	cpu-release-addr = <0x0 0x0000fff8>;	
};

&cpu1 {
	enable-method = "spin-table";
	cpu-release-addr = <0x0 0x0000fff8>;	
};

/ {
	psci {
		status = "disabled";
	};
};